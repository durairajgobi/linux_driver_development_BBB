// SPDX-License-Identifier: GPL-2.0
/*
 * regmap_demo.dts - Device Tree overlay for the regmap_demo driver
 *
 * Attaches a "regmap-demo" I2C device (MPU6050/6500 class IMU) at address
 * 0x68 under the BeagleBone Black's i2c2 controller (P9_19 SCL, P9_20 SDA).
 * i2c2 is enabled and pin-muxed by the base device tree already.
 *
 * Build:   make dtbo
 * Install: make install && sudo reboot      (U-Boot: /boot/uEnv.txt)
 */

/dts-v1/;
/plugin/;

/ {
    compatible = "ti,am335x-bone-black", "ti,am335x-bone", "ti,am33xx";

    fragment@0 {
        target = <&i2c2>;
        __overlay__ {
            #address-cells = <1>;
            #size-cells = <0>;

            regmap_demo: regmap-demo@68 {
                compatible = "mpcoding,regmap-demo";
                reg = <0x68>;
                status = "okay";
            };
        };
    };

    /*
     * Note: the Raspberry Pi firmware's "__overrides__" (dtparam=addr=...)
     * has no equivalent in U-Boot - edit reg above and rebuild instead.
     */
};
