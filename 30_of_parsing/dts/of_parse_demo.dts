/dts-v1/;
/plugin/;

#include <dt-bindings/gpio/gpio.h>
#include <dt-bindings/pinctrl/am33xx.h>

/{
	compatible = "ti,am335x-bone-black", "ti,am335x-bone", "ti,am33xx";

	/* P9_23 (pad conf_gpmc_a1) -> mode 7 = GPIO1_17, output */
	fragment@0 {
		target = <&am33xx_pinmux>;
		__overlay__ {
			of_parse_demo_pins: of-parse-demo-pins {
				pinctrl-single,pins = <
					AM33XX_PADCONF(AM335X_PIN_GPMC_A1, PIN_OUTPUT_PULLUP, MUX_MODE7) /* P9_23 gpio1_17 */
				>;
			};
		};
	};

	fragment@1 {
		target-path = "/";
		__overlay__ {
			of_parse_demo: of-parse-demo {
				compatible = "mpcoding,of-parse-demo";
				status = "okay";

				pinctrl-names = "default";
				pinctrl-0 = <&of_parse_demo_pins>;

				/* string property */
				mpcoding,device-name = "sensor-alpha";

				/* single u32 property */
				mpcoding,sample-rate-hz = <100>;

				/* u32 array property */
				mpcoding,thresholds = <10 20 30>;

				/* presence-only boolean property */
				mpcoding,enable-feature;

				/* GPIO property - P9_23 = GPIO1_17, active low */
				reset-gpios = <&gpio1 17 GPIO_ACTIVE_LOW>;
			};
		};
	};
};
